## u-boot/board/viyara/ve-6ull-14x14/Kconfig
```kconfig
if TARGET_VE_6ULL_14X14

config SYS_BOARD
	default "ve-6ull-14x14"

config SYS_VENDOR
	default "viyara"

config SYS_CONFIG_NAME
	default "ve-6ull-14x14"

config SYS_TEXT_BASE
	default 0x87800000
endif
```
